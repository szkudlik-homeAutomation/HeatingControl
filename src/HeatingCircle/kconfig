## src/HeatingCircle/kconfig
```kconfig
menuconfig HEATING_CIRCLE_CONTROL
    bool "Heating Control main application"
    select SENSORS
    select DS1820_SENSOR
    default n
    help
        Heating Control main application
        
config HEATING_CIRCLE_CONTROL_STATUS_SENSOR
    bool "Heating Control Status Sensor"
    default y
    depends on HEATING_CIRCLE_CONTROL
    select SENSORS
    help
        Heating Control Status Sensor
        
config HEATING_CIRCLE_CONTROL_SERVLET
    bool "Heating Control Servlet"
    default y
    depends on HEATING_CIRCLE_CONTROL
    select HTTP_SERVER
    select NETWORK
    help
        HTTP servlet for external control of Heating Control

config HEATING_CIRCLE_PUMP_DISABLE_THOLD_SHIFT
	int "pump disable thold"
    depends on HEATING_CIRCLE_CONTROL
	default -4
	help 
		stop the pumps if heating water supply temp drops below target_temp + PUMP_DISABLE_THOLD_SHIFT
	
config HEATING_CIRCLE_PUMP_DISABLE_MAX_TEMP
	int "pump disable max temp"
    depends on HEATING_CIRCLE_CONTROL
	default 36
	help 
		never stop pumps if heating water supply temp is higher than PUMP_DISABLE_MAX_TEMP

config HEATING_CIRCLE_PUMP_ENABLE_THOLD_SHIFT
	int "Pump restart thold"
    depends on HEATING_CIRCLE_CONTROL
	default 0
	help 
		restart pump if heating storage temp raise higer than target_temp + PUMP_ENABLE_THOLD_SHIFT
		
config HEATING_CIRCLE_PUMP_FORCE_ENABLE_TEMP
	int "Pump restart force"
    depends on HEATING_CIRCLE_CONTROL
	default 36
	help 
		always restart pumps if heating water supply temp is higher than PUMP_ENABLE_PUMPS_FORCE
```
